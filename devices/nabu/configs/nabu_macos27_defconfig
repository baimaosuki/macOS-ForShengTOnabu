## devices/nabu/configs/nabu_macos27_defconfig
```kconfig
CONFIG_XNU_BUILD_ARCHIVES=y
CONFIG_XNU_CRYPTO_BOOTSTRAP="source"
CONFIG_XNU_DT_PANIC_REGION=y
CONFIG_XNU_ARMVIRT_PLATFORM=n
CONFIG_XNU_KERNEL_CHAINED_FIXUPS=y
CONFIG_XNU_SOURCE_STORAGE=y
CONFIG_XNU_SOURCE_STORAGE_TABLES="userdata"
CONFIG_XNU_EXTRA_LD_ARCHIVES="-Wl,-force_load,{tree}/build/sheng-source-storage/libShengSourceStorage.a"
CONFIG_XNU_OWNER_ROOT_AUDIT=y
CONFIG_XNU_OWNER_ROOT_TRUST=y
CONFIG_XNU_NATIVE_RAM_BLOCK=y
CONFIG_XNU_OWNER_CACHE_MOUNT=y
CONFIG_XNU_OWNER_CACHE_STARTUP=y
CONFIG_XNU_OWNER_BOOT_MANIFEST=y
CONFIG_XNU_OWNER_DATA_MOUNT=y
CONFIG_XNU_OWNER_UNION_SYSTEMOS=y
CONFIG_XNU_OWNER_DATA_VOLUME_UUID="9690079A-E604-4C90-BECF-6439B72FB1BF"
CONFIG_XNU_NATIVE_LEGACY_DISPLAY=y
CONFIG_XNU_NATIVE_ADRENO=n
# The source-storage recipe owns the deferred original-family AES/RAM classes.
CONFIG_XNU_NATIVE_AES=n
```
